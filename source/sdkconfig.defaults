## source/sdkconfig.defaults
```kconfig
# ESP-IDF Configuration for PsychOS Keyboard Firmware

# Flash Configuration
CONFIG_ESPTOOLPY_FLASHSIZE_8MB=y
CONFIG_ESPTOOLPY_FLASHSIZE="8MB"
CONFIG_PARTITION_TABLE_SINGLE_APP=y

# USB Configuration
CONFIG_TINYUSB_ENABLED=y
CONFIG_TINYUSB_HID_ENABLED=y
CONFIG_TINYUSB_CDC_ENABLED=y
CONFIG_TINYUSB_HID_COUNT=2

# Bluetooth Configuration
CONFIG_BT_ENABLED=y
CONFIG_BT_BLUEDROID_ENABLED=y
CONFIG_BT_BLE_ENABLED=y
CONFIG_BT_GATT_ENABLE=y
CONFIG_BT_GATTC_ENABLE=y
CONFIG_BT_GATTS_ENABLE=y

# FreeRTOS Configuration
CONFIG_FREERTOS_HZ=1000
CONFIG_FREERTOS_USE_TRACE_FACILITY=y
CONFIG_FREERTOS_USE_STATS_FORMATTING_FUNCTIONS=y

# SPI Configuration
CONFIG_SPI_MASTER_IN_IRAM=y

# RMT (for NeoPixel)
CONFIG_RMT_ISR_IRAM_SAFE=y

# GPIO Configuration
CONFIG_GPIO_ESP32_SUPPORT_SWITCH_SLP_PULL=y

# CPU Frequency
CONFIG_ESP32S3_DEFAULT_CPU_FREQ_160=y

# UART Configuration
CONFIG_ESP_CONSOLE_UART_DEFAULT=y
CONFIG_ESP_CONSOLE_UART_NUM=0
CONFIG_ESP_CONSOLE_UART_BAUDRATE=115200

# Memory Configuration
CONFIG_ESP_MAIN_TASK_STACK_SIZE=8192
CONFIG_ESP_SYSTEM_EVENT_TASK_STACK_SIZE=4096

# Compiler options
CONFIG_COMPILER_CXX_EXCEPTIONS=y
CONFIG_COMPILER_CXX_RTTI=y
```
